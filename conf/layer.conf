## conf/layer.conf
```bitbake
BBPATH .= ":${LAYERDIR}"

BBFILES += " \
${LAYERDIR}/recipes-*/*/*.bb \
${LAYERDIR}/recipes-*/*/*.bbappend \
"

BBFILE_COLLECTIONS += "meta-user-aa1"
BBFILE_PATTERN_meta-user-aa1 = "^${LAYERDIR}/"
BBFILE_PRIORITY_meta-user-aa1 = "10"

LAYERVERSION = "1"
LAYERDEPENDS_meta-user-aa1 += "meta-enclustra-module"

LAYERSERIES_COMPAT_meta-user-aa1 = "mickledore"
```

## conf/machine/me-st1-generic.conf
```bitbake
## machine.conf for the st1 carrier board

## preamble
MACHINEOVERRIDES =. "${@['', 'me-st1-generic:']['me-st1-generic' != '${MACHINE}']}"

## postabmle
PACKAGE_EXTRA_ARCHS:append = "${@['', ' me-st1-generic']['me-st1-generic' != "${MACHINE}"]}"
```

## conf/machine/refdes-me-aa1-270-2i2-d11e-nfx3-st1.conf
```bitbake
#@TYPE: Machine
#@NAME: refdes-me-aa1-270-2i2-d11e-nfx3-st1
#@DESCRIPTION: Machine configuration for the refdes-me-aa1-270-2i2-d11e-nfx3-st1 boards.

#### Preamble
MACHINEOVERRIDES =. "${@['', 'refdes-me-aa1-270-2i2-d11e-nfx3-st1:']['refdes-me-aa1-270-2i2-d11e-nfx3-st1' !='${MACHINE}']}"
#### Regular settings follow

# Required generic machine inclusion
require conf/machine/me-aa1-270-2i2-d11e-nfx3.conf
require conf/machine/me-st1-generic.conf

WKS_FILE ?= "sdimage-enclustra-arria10.wks"
IMAGE_FSTYPES:append = " wic"

#### No additional settings should be after the Postamble
#### Postamble
PACKAGE_EXTRA_ARCHS:append = "${@['', ' refdes_me-aa1-270-2i2-d11e-nfx3_st1']['refdes-me-aa1-270-2i2-d11e-nfx3-st1' != '${MACHINE}']}"
```

## wic/devel-image-data.wks
```
part --source bootimg-partition --ondisk mmcblk --fstype=vfat --mkfs-extraopts "-F 32" --label boot --active --align 1024 --fixed-size 150M --system-id b
part --source rawcopy --sourceparams="file=u-boot-splx4.sfp" --ondisk mmcblk --system-id=a2 --align 1024 --fixed-size 2M
part / --source rootfs --ondisk mmcblk --fstype=ext4 --label root --align 1024 --fixed-size 400M
part /data --ondisk mmcblk0 --fstype=vfat --label data --align 4 --size 1G --fsoptions "defaults,noauto"
```

## wic/devel-image-minimal.wks
```
part --source bootimg-partition --ondisk mmcblk --fstype=vfat --mkfs-extraopts "-F 32" --label boot --active --align 1024 --fixed-size 50M --system-id b
part --source rawcopy --sourceparams="file=u-boot-splx4.sfp" --ondisk mmcblk --system-id=a2 --align 1024 --fixed-size 2M
part / --source rootfs --ondisk mmcblk --fstype=ext4 --label root --align 1024 --fixed-size 400M
```
